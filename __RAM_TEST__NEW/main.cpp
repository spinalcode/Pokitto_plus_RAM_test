#define screenWidth 400

int sx=0;
int sy=0;

#include <Pokitto.h>

#include "globals.h"
#include "buttonhandling.h"
#include "ram.i"

#define MISO_pin P1_21
#define MOSI_pin P1_22
#define SCLK_pin P1_20
#define CS_pin P1_5


SPI spi(MOSI_pin, MISO_pin, SCLK_pin); // mosi, miso, sclk
DigitalInOut cs(CS_pin);

char tempText[64];

unsigned char rawData[871] = {
	0x50, 0x52, 0x4F, 0x43, 0x45, 0x53, 0x53, 0x4F, 0x52, 0x0D, 0x0A, 0x4E,
	0x58, 0x50, 0x20, 0x41, 0x52, 0x4D, 0x20, 0x43, 0x6F, 0x72, 0x74, 0x65,
	0x78, 0x2D, 0x4D, 0x30, 0x2B, 0x20, 0x70, 0x72, 0x6F, 0x63, 0x65, 0x73,
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	0x20, 0x34, 0x20, 0x6D, 0x6D, 0x0D, 0x0A
};







void sendToRAM(int address, uint8_t* data, int howLong) {
    
    while (cs == 0) {
        wait_us(1);
    }

    SPI spi(MOSI_pin, MISO_pin, SCLK_pin); // mosi, miso, sclk
    cs.output();
    cs=0;

    spi.write(0x02); // Write command

    // assume SIZEOFRAM == 1024
    uint8_t temp = address >> 16;
    spi.write(temp);
    temp = address >> 8;
    spi.write(temp);
    temp = address & 255;
    spi.write(temp);

    for(int t=0; t<howLong; t++){
        spi.write(data[t]);
    }
    cs.input();

}

void getFromRAM(int address, uint8_t* data, int howLong) {

    while (cs == 0) {
        wait_us(1);
    }

    SPI spi(MOSI_pin, MISO_pin, SCLK_pin); // mosi, miso, sclk
    cs.output();
    cs=0;

    spi.write(0x03); // Read command

    // assume SIZEOFRAM == 1024
    uint8_t temp = address >> 16;
    spi.write(temp);
    temp = address >> 8;
    spi.write(temp);
    temp = address & 255;
    spi.write(temp);

    for(int t=0; t<howLong; t++){
        data[t] = spi.write(0x00); // sending dummy bytes will also read the MISO
    }
    cs.input();
}


int main(){
    using PC=Pokitto::Core;
    using PD=Pokitto::Display;
    using PB=Pokitto::Buttons;
    using PS=Pokitto::Sound;

    PC::begin();
    PD::invisiblecolor = 0;
    PD::adjustCharStep = 1;
    PD::adjustLineStep = 0;
    PD::setFont(font3x5);
    
    Pokitto::Display::load565Palette(background1_pal); // load a palette the same way as any other palette in any other screen mode

    // Setup the spi for 8 bit data, high steady state clock,
    // second edge capture, with a 1MHz clock rate
    spi.format(8, 3);
    spi.frequency(20000000);

    while( PC::isRunning() ){

        if(!PC::update()) continue;
        updateButtons();
        PD::clear();
        cs.input();
        PD::print(0,16,cs);


        if(_A[NEW]){
            if(cs==1){
                int number = 1536;
                uint8_t dataBuffer[1536];
                getFromRAM(0x00, dataBuffer, number);
        
                int x=0;
                int y=0;
                for(int t=0; t<number; t++){
                    x++;
                    if(dataBuffer[t]==13){
                        x=0;
                        y++;
                    }else{
                        if(x<55 && y<30) PD::print(x*4,y*7,dataBuffer[t]);
                    }
                }
            }
        }

        if(_B[NEW])        {
            if(cs==1){
                int number = sizeof(rawData);
                sendToRAM(0x00, rawData, number);
            }
        }
        
        sprintf(tempText,"FPS:%d",fpsCount);
        PD::print(0,0,tempText);

        fpsCounter++;

        if(PC::getTime() >= lastMillis+1000){
            PD::clear();
            lastMillis = PC::getTime();
            fpsCount = fpsCounter;
            fpsCounter = 0;
        }

    }
    
    return 0;
}
